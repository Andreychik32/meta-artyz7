## conf/machine/zynq-artyz7-sdt-full.conf
```bitbake
#@TYPE: Machine
#@NAME: zynq-artyz7-sdt-full
#@DESCRIPTION: Machine configuration for the zynq-artyz7-sdt-full boards.

BBMULTICONFIG += "zynq-artyz7-sdt-full-cortexa9-fsbl"

#### Preamble
MACHINEOVERRIDES =. "${@['', 'zynq-artyz7-sdt-full:']['zynq-artyz7-sdt-full' !='${MACHINE}']}"
#### Regular settings follow

# First Stage Boot Loader
FSBL_DEPENDS = ""
FSBL_MCDEPENDS = "mc::zynq-artyz7-sdt-full-cortexa9-fsbl:fsbl-firmware:do_deploy"
FSBL_DEPLOY_DIR = "${TMPDIR}-zynq-artyz7-sdt-full-cortexa9-fsbl/deploy/images/${MACHINE}"

# Set the default (linux) domain device tree
CONFIG_DTFILE_DIR := "${@bb.utils.which(d.getVar('BBPATH'), 'conf/dts/zynq-artyz7-sdt-full')}"
CONFIG_DTFILE ?= "${CONFIG_DTFILE_DIR}/cortexa9-linux.dts"
CONFIG_DTFILE[vardepsexclude] += "CONFIG_DTFILE_DIR"

# Set DDR Base address for u-boot-xlnx-scr variables
DDR_BASEADDR ?= "0x100000"
SKIP_APPEND_BASEADDR ?= "0"

# Yocto KERNEL Variables
UBOOT_ENTRYPOINT  ?= "0x200000"
UBOOT_LOADADDRESS ?= "0x200000"
KERNEL_EXTRA_ARGS += "UIMAGE_LOADADDR=${UBOOT_ENTRYPOINT}"

# Yocto MACHINE_FEATURES Variable
MACHINE_FEATURES += "fpga-overlay"

# Required generic machine inclusion
require conf/machine/zynq-generic.conf

# This is an 'SDT' based BSP
XILINX_WITH_ESW = "sdt"

# Original SDT artifacts URL
SDT_URI = "file:///home/andrii/yocto-artyz7/meta-artyz7/sdt"
SDT_URI[S] = "${WORKDIR}/home/andrii/yocto-artyz7/meta-artyz7/sdt"

# Set the system device trees
SYSTEM_DTFILE_DEPENDS = "sdt-artifacts"
SYSTEM_DTFILE_DIR = "${RECIPE_SYSROOT}${datadir}/sdt/${MACHINE}"
SYSTEM_DTFILE = "${SYSTEM_DTFILE_DIR}/system-top.dts"

# Load the dynamic machine features
include conf/machine/include/zynq-artyz7-sdt-full/${BB_CURRENT_MC}-features.conf
LIBXIL_CONFIG = "conf/machine/include/zynq-artyz7-sdt-full/${BB_CURRENT_MC}-libxil.conf"

# Update bootbin to use proper device tree
BIF_PARTITION_IMAGE[device-tree] = "${RECIPE_SYSROOT}/boot/devicetree/${@os.path.basename(d.getVar('CONFIG_DTFILE').replace('.dts', '.dtb'))}"

# Remap boot files to ensure the right device tree is listed first
IMAGE_BOOT_FILES =+ "devicetree/${@os.path.basename(d.getVar('CONFIG_DTFILE').replace('.dts', '.dtb'))}"

#### No additional settings should be after the Postamble
#### Postamble
PACKAGE_EXTRA_ARCHS:append = "${@['', ' zynq_artyz7_sdt_full']['zynq-artyz7-sdt-full' != '${MACHINE}']}"
```

## conf/machine/zynq-artyz7-xsct.conf
```bitbake
#@TYPE: Machine
#@NAME: zynq-artyz7-xsct
#@DESCRIPTION: Machine configuration for the zynq-artyz7-xsct boards.

#### Preamble
MACHINEOVERRIDES =. "${@['', 'zynq-artyz7-xsct:']['zynq-artyz7-xsct' !='${MACHINE}']}"
#### Regular settings follow

# Yocto device-tree variables
YAML_CONSOLE_DEVICE_CONFIG:pn-device-tree ?= "ps7_uart_0"
YAML_MAIN_MEMORY_CONFIG:pn-device-tree ?= "ps7_ddr_0"
DT_PADDING_SIZE:pn-device-tree ?= "0x1000"
DTC_FLAGS:pn-device-tree ?= ""
YAML_DT_BOARD_FLAGS ?= "{BOARD template}"

# Yocto u-boot-xlnx variables
UBOOT_MACHINE ?= "xilinx_zynq_virt_defconfig"

# Yocto FSBL variables
YAML_SERIAL_CONSOLE_STDIN:pn-fsbl-firmware ?= "ps7_uart_0"
YAML_SERIAL_CONSOLE_STDOUT:pn-fsbl-firmware ?= "ps7_uart_0"

# Serial Console Settings
SERIAL_CONSOLES ?= "115200;ttyPS0"
YAML_SERIAL_CONSOLE_BAUDRATE ?= "115200"

# Set DDR Base address for u-boot-xlnx-scr variables
DDR_BASEADDR ?= "0x0"
SKIP_APPEND_BASEADDR ?= "0"

# Yocto KERNEL Variables
UBOOT_ENTRYPOINT  ?= "0x200000"
UBOOT_LOADADDRESS ?= "0x200000"
KERNEL_EXTRA_ARGS += "UIMAGE_LOADADDR=${UBOOT_ENTRYPOINT}"

# Required generic machine inclusion
require conf/machine/zynq-generic.conf

# This is an 'XSCT' based BSP
XILINX_XSCT_VERSION = "2024.2"
XILINX_WITH_ESW = "xsct"

# Add system XSA
HDF_URI = "file:///home/andrii/yocto-artyz7/meta-artyz7/arty-z7.xsa"
HDF_URI[sha256sum] = "65c8a54b43791f7277d3eae225206147ff508b031514ee6eae03d6eee8ba51aa"
HDF_URI[S] = "${WORKDIR}/home/andrii/yocto-artyz7/meta-artyz7"

#### No additional settings should be after the Postamble
#### Postamble
PACKAGE_EXTRA_ARCHS:append = "${@['', ' zynq_artyz7_xsct']['zynq-artyz7-xsct' != '${MACHINE}']}"
```
