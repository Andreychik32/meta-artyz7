/dts-v1/;
/plugin/;
&fpga_full{
	firmware-name = "arty-z7.bit.bin";
};
&amba{
	clocking0: clocking0 {
		compatible = "xlnx,fclk";
		assigned-clocks = <&clkc 0xf>;
		assigned-clock-rates = <0x5f5e100>;
		#clock-cells = <0x0>;
		clock-output-names = "fabric_clk";
		clocks = <&clkc 0xf>;
	};
};
&amba{
	axi_gpio_0: gpio@41200000 {
		xlnx,gpio-board-interface = "leds_4bits";
		compatible = "xlnx,axi-gpio-2.0", "xlnx,xps-gpio-1.00.a";
		xlnx,all-outputs = <0x1>;
		#gpio-cells = <0x2>;
		xlnx,gpio-width = <0x4>;
		xlnx,rable = <0x0>;
		xlnx,dout-default = <0x0>;
		xlnx,is-dual = <0x1>;
		xlnx,ip-name = "axi_gpio";
		xlnx,tri-default-2 = <0xffffffff>;
		reg = <0x41200000 0x10000>;
		xlnx,all-inputs-2 = <0x1>;
		clocks = <&clkc 0xf>;
		xlnx,all-outputs-2 = <0x0>;
		gpio-controller;
		xlnx,interrupt-present = <0x0>;
		xlnx,gpio2-board-interface = "btns_4bits";
		xlnx,edk-iptype = "PERIPHERAL";
		xlnx,dout-default-2 = <0x0>;
		status = "okay";
		xlnx,gpio2-width = <0x4>;
		clock-names = "s_axi_aclk";
		xlnx,use-board-flow;
		xlnx,tri-default = <0xffffffff>;
		xlnx,name = "axi_gpio_0";
		xlnx,all-inputs = <0x0>;
	};
};